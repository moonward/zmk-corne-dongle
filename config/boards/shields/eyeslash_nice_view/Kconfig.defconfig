## config/boards/shields/eyeslash_nice_view/Kconfig.defconfig
```kconfig
# Copyright (c) 2023 The ZMK Contributors
# SPDX-License-Identifier: MIT
#
# Fork of the stock nice_view shield with the peripheral-side
# balloon/mountain decorative art removed. Battery + connection
# status are kept.

if SHIELD_EYESLASH_NICE_VIEW

config LS0XX_VCOM_THREAD_PRIO
    default 11

config LV_Z_VDB_SIZE
    default 100

config LV_DPI_DEF
    default 161

config LV_Z_BITS_PER_PIXEL
    default 1

choice LV_COLOR_DEPTH
    default LV_COLOR_DEPTH_1
endchoice

choice ZMK_DISPLAY_WORK_QUEUE
    default ZMK_DISPLAY_WORK_QUEUE_DEDICATED
endchoice

choice ZMK_DISPLAY_STATUS_SCREEN
    default ZMK_DISPLAY_STATUS_SCREEN_CUSTOM
endchoice

config LV_Z_MEM_POOL_SIZE
    default 8192

config EYESLASH_NICE_VIEW_WIDGET_STATUS
    bool
    default y
    select LV_FONT_MONTSERRAT_16
    select LV_USE_IMAGE
    select LV_USE_CANVAS

if !ZMK_SPLIT || ZMK_SPLIT_ROLE_CENTRAL

config EYESLASH_NICE_VIEW_WIDGET_STATUS
    select LV_FONT_MONTSERRAT_18
    select LV_FONT_MONTSERRAT_14
    select LV_FONT_UNSCII_8
    select ZMK_WPM

endif # !ZMK_SPLIT || ZMK_SPLIT_ROLE_CENTRAL

endif # SHIELD_EYESLASH_NICE_VIEW
```

## config/boards/shields/eyeslash_nice_view/Kconfig.shield
```kconfig
# Copyright (c) 2022 The ZMK Contributors
# SPDX-License-Identifier: MIT

config SHIELD_EYESLASH_NICE_VIEW
    def_bool $(shields_list_contains,eyeslash_nice_view)
```

## config/west.yml
```yaml
manifest:
  remotes:
    - name: zmkfirmware
      url-base: https://github.com/zmkfirmware
    - name: tokyo2006
      url-base: https://github.com/tokyo2006
    - name: carrefinho
      url-base: https://github.com/carrefinho
    - name: englmaxi
      url-base: https://github.com/englmaxi
    - name: moonward
      url-base: https://github.com/moonward
  projects:
    - name: zmk
      remote: zmkfirmware
      revision: 484a0547078228f6957ed164523823e39fbedec4  # main @ 2026-07-05, needed for Zephyr 4.1 (prospector new-status-screens)
      import: app/west.yml
    - name: prospector-zmk-module                 # <--- and these
      remote: moonward                           # <--- fork: Operator battery redesign (see customize-operator-battery branch)
      revision: cc5a1f521d4afedb7c7a6423e7d07f211b080531  # customize-operator-battery @ 2026-07-09, 2-digit cap (100%->00), 48pt
  self:
    path: config
```
